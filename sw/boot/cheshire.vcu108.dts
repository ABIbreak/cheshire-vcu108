// Copyright 2024 ETH Zurich and University of Bologna.
// Solderpad Hardware License, Version 0.51, see LICENSE for details.
// SPDX-License-Identifier: SHL-0.51
//
// Cyril Koenig <cykoenig@iis.ee.ethz.ch>
// Mojtaba Rostami <m.rostami1989@gmail.com>

/include/ "cheshire.dtsi"

&spi {
  // Boot from micro-SD card (J83) on CS0.
  // The VCU108 has no user-accessible SPI NOR flash.
  boot-with = <0>;
  mmc@0 {
    compatible = "mmc-spi-slot";
    reg = <0>; // CS
    spi-max-frequency = <25000000>;
    voltage-ranges = <3300 3300>;
    disable-wp;
  };
};
